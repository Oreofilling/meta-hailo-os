## meta-hailo-camthink/conf/layer.conf
```bitbake
# meta-hailo-camthink is the layer (meta-hailo-os is the repo root only)
BBPATH .= ":${LAYERDIR}"

BBFILES += "${LAYERDIR}/recipes-*/*/*.bb \
            ${LAYERDIR}/recipes-*/*/*.bbappend"

BBFILE_COLLECTIONS += "meta-hailo-camthink"
BBFILE_PATTERN_meta-hailo-camthink = "^${LAYERDIR}/"
BBFILE_PRIORITY_meta-hailo-camthink = "10"

LAYERDEPENDS_meta-hailo-camthink = "core meta-hailo-bsp"
LAYERSERIES_COMPAT_meta-hailo-camthink = "kirkstone"
```

## meta-hailo-camthink/conf/machine/hailo15-ne503.conf
```bitbake
# Machine hailo15-ne503 for CamThink AIPC (meta-hailo-camthink)
require conf/machine/include/hailo15-base.inc
require conf/machine/include/hailo-vpu-base.inc
require conf/machine/include/camthink-aipc-base.inc

# U-Boot defconfig and DTS provided by meta-hailo-camthink
UBOOT_MACHINE = "hailo15_ne503_defconfig"
```

## meta-hailo-camthink/conf/machine/include/camthink-aipc-base.inc
```bitbake
# CamThink AIPC Platform Base Configuration
# This file contains platform-specific configuration for CamThink AIPC

# Enable systemd as init manager (required for containerd service)
INIT_MANAGER = "systemd"

# Enable virtualization support for containerd
DISTRO_FEATURES:append = " virtualization"
```
